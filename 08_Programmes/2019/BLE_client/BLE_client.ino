#include <BLEDevice.h>
#include <BLEUtils.h>
#include <BLEScan.h>
#include <BLEAdvertisedDevice.h>
#include <HardwareSerial.h>
#include <Adafruit_GFX.h>
#include <Adafruit_SSD1351.h>
#include <SPI.h>

#define BUFFER_SIZE 8
#define WRITE_CONTROL 255

#define COLOR_DEPTH 16
#define  BLACK           0x0000
#define BLUE            0x001F
#define RED             0xF800
#define GREEN           0x07E0
#define CYAN            0x07FF
#define MAGENTA         0xF81F
#define YELLOW          0xFFE0
#define WHITE           0xFFFF

#define MOSI_PIN 11
#define SCLK_PIN 9
#define RST_PIN 12
#define DC_PIN 13
#define CS_PIN 14

Adafruit_SSD1351 tft = Adafruit_SSD1351(128, 128, CS_PIN, DC_PIN, MOSI_PIN, SCLK_PIN, RST_PIN);
static const int spiClk = 15000000;

uint16_t heart[] = {0x0000, 0x0000, 0x0000, 0x0000, 0x0000, 0x0000, 0x0000, 0x0000, 0x0000, 0x0000, 0x0000, 0x0000, 0x0000, 0x0000, 0x0000, 0x0000, 0x0000, 0x0000, 0x0000, 0x0000, 0x0000, 0x0000, 0x0000,
                    0x0000, 0x0000, 0x0000, 0x0000, 0x0000, 0xffff, 0xffff, 0xffff, 0x0000, 0x0000, 0x0000, 0x0000, 0x0000, 0x0000, 0x0000, 0xffff, 0xffff, 0xffff, 0x0000, 0x0000, 0x0000, 0x0000, 0x0000,
                    0x0000, 0x0000, 0x0000, 0xffff, 0xffff,  0xf800,  0xf800,  0xf800, 0xffff, 0x0000, 0x0000, 0x0000, 0x0000, 0x0000, 0xffff,  0xf800,  0xf800,  0xf800, 0xffff, 0xffff, 0x0000, 0x0000, 0x0000,
                    0x0000, 0x0000, 0xffff,  0xf800,  0xf800,  0xf800,  0xf800,  0xf800,  0xf800, 0xffff, 0x0018, 0x0000, 0x0018, 0xffff,  0xf800,  0xf800,  0xf800,  0xf800,  0xf800,  0xf800, 0xffff, 0x0000, 0x0000,
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                    0x0000, 0x0000, 0x0000, 0x0000, 0x0000, 0x0000, 0x0000, 0x0000, 0x0000, 0x0000, 0x0000, 0x0000, 0x0000, 0x0000, 0x0000, 0x0000, 0x0000, 0x0000, 0x0000, 0x0000, 0x0000, 0x0000, 0x0000
                   };

uint16_t time0[] = {0x0000, 0x0000, 0x0000, 0x0000, 0x0000, 0x0000, 0x0000, 0x0000, 0x0000, 0x0000, 0x0000, 0x0000, 0x0000,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 0x0000,
                    0x0000, 0xffff, 0xffff, 0xffff, 0xffff, 0xffff, 0xffff, 0xffff, 0xffff, 0xffff, 0xffff, 0xffff,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 0x0000,
                    0x0000, 0xffff, 0x0000, 0x0000, 0x0000, 0x0000, 0x0000, 0x0000, 0x0000, 0x0000, 0x0000, 0x0000,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 0x0000,
                    0x0000, 0xffff, 0x0000, 0xffff, 0xffff, 0xffff, 0xffff, 0xffff, 0xffff, 0xffff, 0xffff, 0xffff,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 0x0000,
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                    0x0000, 0x0000, 0x0000, 0x0000, 0x0000, 0x0000, 0x0000, 0x0000, 0x0000, 0x0000, 0x0000, 0x0000,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 0x0000
                   };

uint16_t time1[] = {0x0000, 0x0000, 0x0000, 0x0000, 0x0000, 0x0000, 0x0000, 0x0000, 0x0000, 0x0000, 0x0000, 0x0000, 0x0000,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 0x0000,
                    0x0000, 0xffff, 0xffff, 0xffff, 0xffff, 0xffff, 0xffff, 0xffff, 0xffff, 0xffff, 0xffff, 0xffff,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 0x0000,
                    0x0000, 0xffff, 0x0000, 0x0000, 0x0000, 0x0000, 0x0000, 0x0000, 0x0000, 0x0000, 0x0000, 0x0000,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 0x0000,
                    0x0000, 0xffff, 0x0000, 0xffff, 0xffff, 0xffff, 0xffff, 0xffff, 0xffff, 0xffff, 0xffff, 0xffff,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 0x0000,
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                    0x0000, 0x0000, 0x0000, 0x0000, 0x0000, 0x0000, 0x0000, 0x0000, 0x0000, 0x0000, 0x0000, 0x0000,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 0x0000
                   };

uint16_t time2[] = {0x0000, 0x0000, 0x0000, 0x0000, 0x0000, 0x0000, 0x0000, 0x0000, 0x0000, 0x0000, 0x0000, 0x0000, 0x0000,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 0x0000,
                    0x0000, 0xffff, 0xffff, 0xffff, 0xffff, 0xffff, 0xffff, 0xffff, 0xffff, 0xffff, 0xffff, 0xffff,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 0x0000,
                    0x0000, 0xffff, 0x0000, 0x0000, 0x0000, 0x0000, 0x0000, 0x0000, 0x0000, 0x0000, 0x0000, 0x0000,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 0x0000,
                    0x0000, 0xffff, 0x0000, 0xffff, 0xffff, 0xffff, 0xffff, 0xffff, 0xffff, 0xffff, 0xffff, 0xffff,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 0x0000,
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                    0x0000, 0x0000, 0x0000, 0x0000, 0x0000, 0x0000, 0x0000, 0x0000, 0x0000, 0x0000, 0x0000, 0x0000,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 0x0000
                   };

uint16_t time3[] = {0x0000, 0x0000, 0x0000, 0x0000, 0x0000, 0x0000, 0x0000, 0x0000, 0x0000, 0x0000, 0x0000, 0x0000, 0x0000,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 0x0000,
                    0x0000, 0xffff, 0xffff, 0xffff, 0xffff, 0xffff, 0xffff, 0xffff, 0xffff, 0xffff, 0xffff, 0xffff,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 0x0000,
                    0x0000, 0xffff, 0x0000, 0x0000, 0x0000, 0x0000, 0x0000, 0x0000, 0x0000, 0x0000, 0x0000, 0x0000,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 0x0000,
                    0x0000, 0xffff, 0x0000,  0xf800,  0xf800,  0xf800,  0xf800,  0xf800,  0xf800,  0xf800,  0xf800,  0xf800,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 0x0000,
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                    0x0000, 0x0000, 0x0000, 0x0000, 0x0000, 0x0000, 0x0000, 0x0000, 0x0000, 0x0000, 0x0000, 0x0000,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 0x0000
                   };

uint16_t arrow[] = {0xffff, 0x0000, 0x0000, 0x0000, 0x0000,
                    0xffff, 0xffff, 0x0000, 0x0000, 0x0000,
                    0xffff, 0xffff, 0xffff, 0x0000, 0x0000,
                    0xffff, 0xffff, 0xffff, 0xffff, 0x0000,
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                    0xffff, 0x0000, 0x0000, 0x0000, 0x0000
                   }; //*/

byte previousState = 0;

byte dataBuffer[BUFFER_SIZE];
HardwareSerial outSer(2);

// The remote service we wish to connect to.
static BLEUUID serviceUUID("b9d4de40-44be-11e9-b210-d663bd873d93"); //A faire matcher avec les UUID du serveur correspondant. UUID de service
// The characteristic of the remote service we are interested in.
static BLEUUID    charUUID("b9d4e282-44be-11e9-b210-d663bd873d93"); //A faire matcher avec les UUID du serveur correspondant. UUID de commande
static BLEUUID    backUUID("861c92c2-4ef6-11e9-8647-d663bd873d93"); //A faire matcher avec les UUID du serveur correspondant. UUID de feedback

static boolean doConnect = false;
static boolean connected = false;
static boolean doScan = false;
static BLERemoteCharacteristic* pRemoteCharacteristic;
static BLERemoteCharacteristic* pRemoteCharacteristicBack;
static BLEAdvertisedDevice* myDevice;

//uint8_t val[8] = {0,0,0,0,0,0,0,0};//*/
uint8_t retVal[2] = {0, 0}; //*/

/*
 * 
 * @func static notifyCallback callback notifier function for event handling (unused but necessary for the BLE client class to work)
 * @param null
 * @return void
 * 
 */

static void notifyCallback(
  BLERemoteCharacteristic* pBLERemoteCharacteristic,
  uint8_t* pData,
  size_t length,
  bool isNotify) {
  Serial.print("Notify callback for characteristic ");
  Serial.print(pBLERemoteCharacteristic->getUUID().toString().c_str());
  Serial.print(" of data length ");
  Serial.println(length);
  Serial.print("data: ");
  Serial.println((char*)pData);
}

class MyClientCallback : public BLEClientCallbacks {

/*
 * 
 * @func onConnect what happens when the client connects
 * @param BLEClient* pointer to the target client instance
 * @return void
 * 
 */
  
    void onConnect(BLEClient* pclient) {
      connected = true;
    }

/*
 * 
 * @func onDisconnect what happens when the client disconnects or loses connection
 * @param BLEClient* pointer to the target client instance
 * @return void
 * 
 */

    void onDisconnect(BLEClient* pclient) {
      connected = false;
      Serial.println("onDisconnect");
    }
};

/*
 * 
 * @func connectToServer connect the client to the server
 * @param null
 * @return bool 
 * 
 */

bool connectToServer() {
  Serial.print("Forming a connection to ");
  Serial.println(myDevice->getAddress().toString().c_str());

  BLEClient*  pClient  = BLEDevice::createClient();
  Serial.println(" - Created client");

  pClient->setClientCallbacks(new MyClientCallback());

  // Connect to the remove BLE Server.
  pClient->connect(myDevice);  // if you pass BLEAdvertisedDevice instead of address, it will be recognized type of peer device address (public or private)
  Serial.println(" - Connected to server");

  // Obtain a reference to the service we are after in the remote BLE server.
  BLERemoteService* pRemoteService = pClient->getService(serviceUUID);
  if (pRemoteService == nullptr) {
    Serial.print("Failed to find our service UUID: ");
    Serial.println(serviceUUID.toString().c_str());
    pClient->disconnect();
    return false;
  }
  Serial.println(" - Found our service");


  // Obtain a reference to the characteristic in the service of the remote BLE server.
  pRemoteCharacteristic = pRemoteService->getCharacteristic(charUUID);
  pRemoteCharacteristicBack = pRemoteService->getCharacteristic(backUUID);
  if (pRemoteCharacteristic == nullptr) {
    Serial.print("Failed to find our characteristic UUID: ");
    Serial.println(charUUID.toString().c_str());
    pClient->disconnect();
    return false;
  }
  Serial.println(" - Found our characteristic");

  // Read the value of the characteristic.
  if (pRemoteCharacteristic->canRead()) {
    std::string value = pRemoteCharacteristic->readValue();
    Serial.print("The characteristic value was: ");
    Serial.println(value.c_str());
  }
  if (pRemoteCharacteristicBack->canRead()) {
    std::string value = pRemoteCharacteristicBack->readValue();
  }

  if (pRemoteCharacteristic->canNotify())
    pRemoteCharacteristic->registerForNotify(notifyCallback);

  if (pRemoteCharacteristicBack->canNotify())
    pRemoteCharacteristicBack->registerForNotify(notifyCallback);

  connected = true;
  return true;
}
/**
   Scan for BLE servers and find the first one that advertises the service we are looking for.
*/
class MyAdvertisedDeviceCallbacks: public BLEAdvertisedDeviceCallbacks {
    /**
        Called for each advertising BLE server.
    */

    /*
     * 
     * @func onResult
     * @param BLEAdvertisedDevice an advertised device found
     * @return void
     * 
     */
     
    void onResult(BLEAdvertisedDevice advertisedDevice) {
      Serial.print("BLE Advertised Device found: ");
      Serial.println(advertisedDevice.toString().c_str());

      // We have found a device, let us now see if it contains the service we are looking for.
      if (advertisedDevice.haveServiceUUID() && advertisedDevice.isAdvertisingService(serviceUUID)) {

        BLEDevice::getScan()->stop();
        myDevice = new BLEAdvertisedDevice(advertisedDevice);
        doConnect = true;
        doScan = true;

      } // Found our server
    } // onResult
}; // MyAdvertisedDeviceCallbacks

/*
 * 
 * @func setup default setup function for arduino
 * @param null
 * @return void
 * 
 */

void setup() {
  delay(1000);
  pinMode(CS_PIN, OUTPUT);
  pinMode(DC_PIN, OUTPUT);
  pinMode(RST_PIN, OUTPUT);
  digitalWrite(RST_PIN, HIGH);
  digitalWrite(DC_PIN, HIGH);

  tft.begin();
  tft.fillRect(0, 0, 128, 128, BLACK);

  outSer.begin(115200, SERIAL_8N1,16,17);
  Serial.begin(115200);
  //pinMode(27, INPUT_PULLUP);
  Serial.println("Starting Arduino BLE Client application...");
  delay(1000);
  BLEDevice::init("");

  // Retrieve a Scanner and set the callback we want to use to be informed when we
  // have detected a new device.  Specify that we want active scanning and start the
  // scan to run for 5 seconds.
  BLEScan* pBLEScan = BLEDevice::getScan();
  pBLEScan->setAdvertisedDeviceCallbacks(new MyAdvertisedDeviceCallbacks());
  pBLEScan->setInterval(1349);
  pBLEScan->setWindow(449);
  pBLEScan->setActiveScan(true);
  pBLEScan->start(5, false);
  delay(1000);
} // End of setup.

/*
 * 
 * @func loop default loop function for arduino
 * @param null
 * @return void
 * 
 */

// This is the Arduino main loop function.
void loop() {
  // If the flag "doConnect" is true then we have scanned for and found the desired
  // BLE Server with which we wish to connect.  Now we connect to it.  Once we are
  // connected we set the connected flag to be true.
  if (doConnect == true) {
    if (connectToServer()) {
      Serial.println("We are now connected to the BLE Server.");

    } else {
      Serial.println("We have failed to connect to the server; there is nothin more we will do.");
    }
    doConnect = false;

  }

  if (connected) {
    std::string feedbackDataServ;
    uint8_t feedbackData[2] = {0, 0};
    Serial.print("1 ");
    Serial.println(millis());

    outSer.write(WRITE_CONTROL); //signal inputs controller that the ESP is ready to read controller data
    while (outSer.available() < 8) {} //do nothing as long as not all the serial inputs are ready to be read
    outSer.readBytes(dataBuffer, BUFFER_SIZE); //read inputs from inputs controller and store into dataBuffer

    Serial.print("2 ");
    Serial.println(millis());
    for (int i = 0; i < 8; i++) {
    Serial.print(dataBuffer[i]);
    Serial.print("   ");
     }
    //Serial.print("3 ");
    //Serial.println(millis());

    // Set the characteristic's value to be the array of bytes that is actually a string.


    pRemoteCharacteristic->writeValue(dataBuffer, 8, 0); //write inputs inside of dataBuffer to BT server
    //Serial.print("4 ");
    //Serial.println(millis());
    feedbackDataServ = pRemoteCharacteristicBack->readValue(); //read feedback data from server
    //Serial.print("5 ");
    //Serial.println(millis());
    Serial.println("read feedback data");
    for (byte i = 0; i < 2; i++) {
      feedbackData[i] = (uint8_t)feedbackDataServ[i];
      Serial.print(feedbackData[i]);
      //Serial.print("a");
      Serial.print("  ");
    }
    //Serial.print("6 ");
    //Serial.println(millis());
    renderScreen(feedbackData[0]);
    //Serial.print("7 ");
    //Serial.println(millis());
    Serial.println("____");
    //TODO:  Treat feedback data (screen, buzzer and so on)

    /*Serial.println(millis());
      Serial.println("----");//*/
  } else if (doScan) {
    BLEDevice::getScan()->start(5, false);  // this is just eample to start scan after disconnect, most likely there is better way to do it in arduino
  }
} // End of loop

/*
 * 
 *  @func displayHearts displays the heart according to the given ID
 *  @param byte ID of the heart to display (1-6)
 *  @return void
 *  
 */

void displayHearts(byte number) { //displays a heart in the nth position
   //tft.setCursor(0,0);
   if (number<4)
   {tft.drawRGBBitmap(2+number*24, 5, heart, 23, 23);}
   else
   {tft.drawRGBBitmap(2+(number-3)*24, 29, heart, 23, 23);}
}

/*
 * 
 * @func displayTimeRemaining displays the proper image for the time remaining
 * @param byte state for the time remaining (0 for most - 3 for least)
 * @return void
 * 
 */

void displayTimeRemaining(byte timeLeftState) { //displays the time icon depending on the state
  switch (timeLeftState) {
    case 0:
      tft.drawRGBBitmap(16, 70, time0, 96, 32);
    break;
    case 1:
      tft.drawRGBBitmap(17, 70, time1, 96, 32);
    break;
    case 2:
      tft.drawRGBBitmap(17, 70, time2, 96, 32);
    break;
    case 3:
      tft.drawRGBBitmap(17, 70, time3, 96, 32);
    break;
    default:
    break;
  }
}

/*
 * 
 * @func goScreen displays the "go" screen (ID 3)
 * @param null
 * @return void
 * 
 */

void goScreen() {
  tft.fillScreen(GREEN);
  tft.setCursor(40,50);
  tft.setTextColor(WHITE);
  tft.setTextSize(4);
  tft.print("GO");
  tft.setCursor(2,80);
  tft.setTextSize(1);
  tft.print("Appuyez sur vert");
  tft.setCursor(2,90);
  tft.print("pour démarrer");
}

/*
 * 
 * @func menu1TextDisplay displays the text for the first menu
 * @param null
 * @return void
 * 
 */

void menu1TextDisplay() {
  tft.setTextSize(2);
  tft.setCursor(25,48);
  tft.setTextColor(WHITE);
  tft.print("Auto");
  tft.setCursor(25, 74);
  tft.print("Manuel");
}

/*
 * 
 * @func menuPauseDisplay displays the text for the pause menu
 * @param null
 *  @return void
 * 
 */

void menuPauseDisplay() {
  tft.setTextSize(2);
  tft.setCursor(15,48);
  tft.setTextColor(WHITE);
  tft.print("Reprendre");
  tft.setCursor(15, 74);
  tft.print("Retour");
  tft.setCursor(15,84);
  tft.print("menu");
}

/*
 * 
 * @func renderScreen main decision function for screen rendering
 * @param byte screen state ID
 * @return void
 * 
 */

void renderScreen(byte state) {//renders the screen depending on the state dictated by the handler
  if (previousState != state) {
    
    tft.fillScreen(BLACK);
  switch (state) {
    case 0:
      previousState = state;
    return;
    break;
    case 1:
      menu1TextDisplay();
      tft.drawRGBBitmap(2, 50, arrow, 5, 9);
    break;
    case 2:
      menu1TextDisplay();
      tft.drawRGBBitmap(2, 76, arrow, 5, 9);
    break;
    case 3: //display GO on a green bgnd
     goScreen();
    break;
    case 4: //display all hearts and time display statuses
      displayHearts(6);
    case 5:
      displayHearts(5);
    case 6:
      displayHearts(4);
    case 7:
      displayHearts(3);
    case 8:
      displayHearts(2);
    case 9:
      displayHearts(1);
      displayTimeRemaining(0);
    break;
    case 10:
      displayHearts(6);
    case 11:
      displayHearts(5);
    case 12:
      displayHearts(4);
    case 13:
      displayHearts(3);
    case 14:
      displayHearts(2);
    case 15:
      displayHearts(1);
      displayTimeRemaining(1);
    break;
    case 16:
      displayHearts(6);
    case 17:
      displayHearts(5);
    case 18:
      displayHearts(4);
    case 19:
      displayHearts(3);
    case 20:
      displayHearts(2);
    case 21:
      displayHearts(1);
      displayTimeRemaining(2);
    break;
    case 22:
      displayHearts(6);
    case 23:
      displayHearts(5);
    case 24:
      displayHearts(4);
    case 25:
      displayHearts(3);
    case 26:
      displayHearts(2);
    case 27:
      displayHearts(1);
      displayTimeRemaining(3);
    break;
    case 28:
      menuPauseDisplay();
      tft.drawRGBBitmap(2, 50, arrow, 5, 9);
    break;
    case 29:
      menuPauseDisplay();
      tft.drawRGBBitmap(2, 76, arrow, 5, 9);
    break;
    default: //transmission error
    tft.setCursor(5,5);
    tft.setTextColor(RED);
    tft.setTextSize(1);
    tft.print("Transmission error");
    break;
  }
  }
  previousState = state;
}
